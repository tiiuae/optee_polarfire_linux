// SPDX-License-Identifier: (GPL-2.0 OR MIT)
/* Copyright (c) 2021 Unikie */

/dts-v1/;

#include "microchip-mpfs-icicle-kit-context-a.dts"

/* Clock frequency (in Hz) of the rtcclk */
#define RTCCLK_FREQ		1000000

/delete-node/ &ddrc_cache_lo;

/ {
	/* TODO: move DMA etc. areas to the end of ddr_lo region
	   to have continous RAM range */
	ddrc_cache_lo: memory@89000000 {
		device_type = "memory";
		reg = <0x0 0x89000000 0x0 0x17000000>;
		clocks = <&clkcfg CLK_DDRC>;
		status = "okay";
	};
};

&mmuart2 {
	status = "disabled"; /* seL4 */
};

&mmuart3 {
	status = "okay";
};
