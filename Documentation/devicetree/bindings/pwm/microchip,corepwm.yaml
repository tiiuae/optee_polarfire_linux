## Documentation/devicetree/bindings/pwm/microchip,corepwm.yaml
```yaml
# SPDX-License-Identifier: (GPL-2.0-only OR BSD-2-Clause)

%YAML 1.2
---
$id: http://devicetree.org/schemas/pwm/microchip,corepwm.yaml#
$schema: http://devicetree.org/meta-schemas/core.yaml#

title: Microchip ip core PWM controller bindings

maintainers:
  - Conor Dooley <conor.dooley@microchip.com>

description: |
  corePWM is an 16 channel pulse width modulator FPGA IP

  https://www.microsemi.com/existing-parts/parts/152118

properties:
  compatible:
    items:
      - const: microchip,corepwm-rtl-v4

  reg:
    maxItems: 1

  clocks:
    maxItems: 1

  "#pwm-cells":
    const: 2

  microchip,sync-update:
    description: |
      In synchronous mode, all channels are updated at the beginning of the PWM period.
      Asynchronous mode is relevant to applications such as LED control, where
      synchronous updates are not required. Asynchronous mode lowers the area size,
      reducing shadow register requirements. This can be set at run time, provided
      SHADOW_REG_EN is asserted. SHADOW_REG_EN is set by the FPGA bitstream programmed
      to the device.
      Each bit corresponds to a PWM channel & represents whether synchronous mode is
      possible for the PWM channel.

    $ref: /schemas/types.yaml#/definitions/uint16
    default: 0

  microchip,dac-mode:
    description: |
      Optional, per-channel Low Ripple DAC mode is possible on this IP core. It creates
      a minimum period pulse train whose High/Low average is that of the chosen duty
      cycle. This "DAC" will have far better bandwidth and ripple performance than the
      standard PWM algorithm can achieve.
      Each bit corresponds to a PWM channel & represents whether dac mode is enabled
      that PWM channel.

    $ref: /schemas/types.yaml#/definitions/uint16
    default: 0

required:
  - compatible
  - reg
  - clocks
  - "#pwm-cells"

additionalProperties: false

examples:
  - |
    #include "dt-bindings/clock/microchip,mpfs-clock.h"
    pwm@41000000 {
      compatible = "microchip,corepwm-rtl-v4";
      microchip,sync-update = /bits/ 16 <0>;
      clocks = <&clkcfg CLK_FIC3>;
      reg = <0x41000000 0xF0>;
      #pwm-cells = <2>;
    };
```

## Documentation/devicetree/bindings/rng/microchip,mpfs-rng.yaml
```yaml
# SPDX-License-Identifier: (GPL-2.0-only OR BSD-2-Clause)
%YAML 1.2
---
$id: "http://devicetree.org/schemas/rng/microchip,mpfs-rng.yaml#"
$schema: "http://devicetree.org/meta-schemas/core.yaml#"

title: Microchip MPFS random number generator

maintainers:
  - Conor Dooley <conor.dooley@microchip.com>

description: |
  The hardware random number generator on the Polarfire SoC is
  accessed via the mailbox interface provided by the system controller


properties:
  compatible:
    const: microchip,mpfs-rng

  microchip,syscontroller:
    description: phandle of the system controller device node
    $ref: "/schemas/types.yaml#/definitions/phandle"

required:
  - compatible
  - microchip,syscontroller

additionalProperties: false

examples:
  - |
    hwrandom: hwrandom {
        compatible = "microchip,mpfs-rng";
        microchip,syscontroller = <&syscontroller>;
    };
```

## Documentation/devicetree/bindings/rtc/microchip,mfps-rtc.yaml
```yaml
# SPDX-License-Identifier: (GPL-2.0-only OR BSD-2-Clause)
%YAML 1.2
---
$id: http://devicetree.org/schemas/rtc/microchip,mfps-rtc.yaml#

$schema: http://devicetree.org/meta-schemas/core.yaml#

title: Microchip PolarFire Soc (MPFS) RTC Device Tree Bindings

allOf:
  - $ref: rtc.yaml#

maintainers:
  - Daire McNamara <daire.mcnamara@microchip.com>
  - Lewis Hanly <lewis.hanly@microchip.com>

properties:
  compatible:
    enum:
      - microchip,mpfs-rtc

  reg:
    maxItems: 1

  interrupts:
    description: |
      The RTC on the PolarFire SoC has a pair of interrupts. The first is the
      RTC_WAKEUP interrupt. The second, RTC_MATCH, is asserted when the
      content of the Alarm register is equal to that of the RTC's count.
    maxItems: 2

  microchip,prescaler:
    description: |
      The prescaler divides the input frequency to create a time-based strobe (typically 1 Hz) for
      the calendar counter. The Alarm and Compare Registers, in conjunction with the calendar
      counter, facilitate time-matched events. To properly operate in Calendar or Binary mode,
      the 26-bit prescaler must be programmed to generate a strobe to the RTC.
    maxItems: 1
    $ref: /schemas/types.yaml#/definitions/uint32

  clocks:
    maxItems: 1

  clock-names:
    items:
      - const: rtc

required:
  - compatible
  - reg
  - interrupts
  - clocks
  - clock-names

additionalProperties: false

examples:
  - |
    #include <dt-bindings/clock/microchip,mpfs-clock.h>
    rtc@20124000 {
        compatible = "microchip,mpfs-rtc";
        reg = <0x20124000 0x1000>;
        clocks = <&clkcfg CLK_RTC>;
        clock-names = "rtc";
        interrupts = <80>, <81>;
    };
...
```

## Documentation/devicetree/bindings/soc/microchip/microchip,mpfs-sys-controller.yaml
```yaml
# SPDX-License-Identifier: (GPL-2.0-only OR BSD-2-Clause)
%YAML 1.2
---
$id: "http://devicetree.org/schemas/soc/microchip/microchip,mpfs-sys-controller.yaml#"
$schema: "http://devicetree.org/meta-schemas/core.yaml#"

title: Microchip PolarFire SoC (MPFS) MSS (microprocessor subsystem) system controller

maintainers:
  - Conor Dooley <conor.dooley@microchip.com>

description: |
  The PolarFire SoC system controller is communicated with via a mailbox.
  This document describes the bindings for the client portion of that mailbox.

properties:
  mboxes:
    maxItems: 1

  compatible:
    items:
      - const: microchip,mpfs-sys-controller

  rng:
    type: object

    description: |
      The hardware random number generator on the Polarfire SoC is
      accessed via the mailbox interface provided by the system controller

    properties:
      compatible:
        const: microchip,mpfs-rng

    required:
      - compatible

  sysserv:
    type: object

    description: |
      The PolarFire SoC system controller is communicated with via a mailbox.
      This binding represents several of the functions provided by the system
      controller which do not belong in a specific subsystem, such as reading
      the fpga device certificate, all of which follow the same format:
        - a command + optional payload sent to the sys controller
        - a status + a payload returned to Linux

    properties:
      compatible:
        const: microchip,mpfs-generic-service

    required:
      - compatible

required:
  - compatible
  - mboxes

additionalProperties: false

examples:
  - |
    syscontroller {
      compatible = "microchip,mpfs-sys-controller";
      mboxes = <&mbox 0>;
      rng: rng {
        compatible = "microchip,mpfs-rng";
      };
      sysserv: sysserv {
        compatible = "microchip,mpfs-generic-service";
      };
    };
```
